## layers/meta-neopios/conf/distro/crank-os.conf
```bitbake
require include/crank-os.inc

DISTRO = "crank-os"
DISTRO_NAME = "CrankOS"
DISTRO_VERSION = "v1.0"

SDK_VENDOR = "-crankos"
SDK_VERSION = "CrankOS-SDK-${DISTRO_VERSION}"

MAINTAINER = "CrankOS <asiminciuc@yahoo.com>"

DISTRO_FEATURES:append = " opengl wayland x11 virtualization security"
INIT_MANAGER = "openrc"
```
